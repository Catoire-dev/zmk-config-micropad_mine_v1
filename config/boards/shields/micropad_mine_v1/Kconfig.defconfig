## config/boards/shields/micropad_mine_v1/Kconfig.defconfig
```kconfig
if SHIELD_MICROPAD_MINE_V1

config ZMK_KEYBOARD_NAME
    default "micropad_mine_v1"

endif
```

## config/boards/shields/micropad_mine_v1/Kconfig.shield
```kconfig
config SHIELD_MICROPAD_MINE_V1
    def_bool $(shields_list_contains,micropad_mine_v1)
```
